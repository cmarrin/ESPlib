## Vesper/espidf/main/Kconfig.projbuild
```kconfig
menu "Blink LED Configuration"

    choice BLINK_LED
        prompt "Blink LED type"
        default BLINK_LED_GPIO
        help
            Select the LED type. A normal level controlled LED or an 
            addressable LED strip. The default selection is based on 
            the Espressif DevKit boards. You can change the default 
            selection according to your board.

        config BLINK_LED_GPIO
            bool "GPIO"
        config BLINK_LED_STRIP
            bool "LED strip"
    endchoice

    choice BLINK_LED_STRIP_BACKEND
        depends on BLINK_LED_STRIP
        prompt "LED strip backend peripheral"
        default BLINK_LED_STRIP_BACKEND_RMT
        help
            Select the backend peripheral to drive the LED strip.

        config BLINK_LED_STRIP_BACKEND_RMT
            bool "RMT"
        config BLINK_LED_STRIP_BACKEND_SPI
            bool "SPI"
    endchoice

    choice BLINK_LED_SENSE
        depends on BLINK_LED_GPIO
        prompt "Is LED GPIP pin active high or low?"
        default BLINK_LED_GPIO_ACTIVE_LOW
        help
            Select whether the LED is on when the GPIO pin is high or low

        config BLINK_LED_GPIO_ACTIVE_LOW
            bool "Active Low"
        config BLINK_LED_GPIO_ACTIVE_HIGH
            bool "Active High"
    endchoice

    config BLINK_LED_GPIO_NUMBER
        int "Blink GPIO number"
        range 0 64
        default 8
        help
            GPIO number (IOxx) to blink on and off the LED. Some
            GPIOs are used for other purposes (flash connections, etc.) 
            and cannot be used to blink. Many boards have an onboard
            LED you can use if you know its GPIO number.

endmenu
```

## Vesper/espidf/sdkconfig.defaults
```kconfig
CONFIG_ESPTOOLPY_FLASHSIZE_16MB=y
CONFIG_ESPTOOLPY_FLASHSIZE="16MB"
CONFIG_ESP_SYSTEM_PANIC_PRINT_HALT=y
CONFIG_PARTITION_TABLE_CUSTOM=y
CONFIG_PARTITION_TABLE_CUSTOM_FILENAME="partitions-16mb.csv"
CONFIG_PARTITION_TABLE_FILENAME="partitions-16mb.csv"
CONFIG_PARTITION_TABLE_OFFSET=0x8000
CONFIG_PARTITION_TABLE_MD5=y
CONFIG_LWIP_MAX_SOCKETS=20
CONFIG_LWIP_HOOK_NETCONN_EXT_RESOLVE_CUSTOM=y
CONFIG_PTHREAD_TASK_STACK_SIZE_DEFAULT=8192
CONFIG_USER_INVERT_LED=n
```

## Vesper/espidf/sdkconfig.defaults.esp32
```kconfig
CONFIG_ESPTOOLPY_FLASHSIZE_4MB=y
CONFIG_ESPTOOLPY_FLASHSIZE="4MB"
CONFIG_ESP_SYSTEM_PANIC_PRINT_HALT=y
CONFIG_PARTITION_TABLE_CUSTOM=y
CONFIG_PARTITION_TABLE_CUSTOM_FILENAME="partitions-4mb.csv"
CONFIG_PARTITION_TABLE_FILENAME="partitions-4mb.csv"
CONFIG_PARTITION_TABLE_OFFSET=0x8000
CONFIG_PARTITION_TABLE_MD5=y
CONFIG_LWIP_MAX_SOCKETS=20
CONFIG_LWIP_HOOK_NETCONN_EXT_RESOLVE_CUSTOM=y
```
